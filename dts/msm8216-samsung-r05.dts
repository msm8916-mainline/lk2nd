// SPDX-License-Identifier: GPL-2.0-only

/dts-v1/;

/include/ "msm8916.dtsi"

/ {
	// This is used by the bootloader to find the correct DTB
	qcom,msm-id = <248 0>;
	qcom,board-id = <0xF808FF01 5>;

	j53g-eur {
		model = "Samsung Galaxy J5 2015 (SM-J500H)";
		compatible = "samsung,j53g-eur", "qcom,msm8916", "lk2nd,device";
		lk2nd,match-bootloader = "J500H*";

		samsung,muic-reset {
			i2c-gpios = <105 106>;
			i2c-address = <0x25>;
		};
	};
};
