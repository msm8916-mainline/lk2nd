// SPDX-License-Identifier: GPL-2.0-only

/dts-v1/;

#include <skeleton.dtsi>

/ {
	// This is used by the bootloader to find the correct DTB
	compatible = "lg,lenok", "qcom,apq8026", "lk2nd,device";
	qcom,msm-id = <199 0x20000>;
	qcom,board-id = <132 0x0a>;

	model = "LG G Watch R";
};
