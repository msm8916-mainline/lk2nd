// SPDX-License-Identifier: GPL-2.0-only

/dts-v1/;

#include <skeleton.dtsi>
#include <lk2nd.h>

/ {
	// This is used by the bootloader to find the correct DTB
	qcom,msm-id = <0xC708FF01 3 0x20000>;

	matissewifi {
		model = "Samsung Galaxy Tab 4 10.1 (SM-T530)";
		compatible = "samsung,matissewifi", "qcom,apq8026", "lk2nd,device";
		lk2nd,match-bootloader = "T530*";

		lk2nd,keys =
			<KEY_HOME       108 (GPIO_PULL_UP | GPIO_ACTIVE_LOW)>,
			<KEY_VOLUMEDOWN 107 (GPIO_PULL_UP | GPIO_ACTIVE_LOW)>,
			<KEY_VOLUMEUP   106 (GPIO_PULL_UP | GPIO_ACTIVE_LOW)>;
	};
};
