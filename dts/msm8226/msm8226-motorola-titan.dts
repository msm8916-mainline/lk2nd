// SPDX-License-Identifier: GPL-2.0-only

/dts-v1/;

#include <skeleton.dtsi>
#include <lk2nd.h>

/ {
	// This is used by the bootloader to find the correct DTB
	qcom,msm-id = <145 0x4b 0x8100>,
				<145 0x4b 0x8200>,
				<145 0x4b 0x8300>,
				<145 0x4b 0x8400>,
				<145 0x4b 0x8500>,
				<145 0x4c 0x8100>,
				<145 0x4c 0x8200>,
				<145 0x4c 0x8300>,
				<145 0x4c 0x8400>,
				<145 0x4c 0x8500>,
				<145 0x4d 0x8100>,
				<145 0x4d 0x8200>,
				<145 0x4d 0x8300>,
				<145 0x4d 0x8400>,
				<145 0x4d 0x8500>,
				<145 0x4e 0x8100>,
				<145 0x4e 0x8200>,
				<145 0x4e 0x8300>,
				<145 0x4e 0x8400>,
				<145 0x4e 0x8500>,
				<145 0x4f 0x8100>,
				<145 0x4f 0x8200>,
				<145 0x4f 0x8300>,
				<145 0x4f 0x8400>,
				<145 0x4f 0x8500>;

	model = "Motorola Moto G 2014";
	compatible = "motorola,titan", "qcom,msm8226", "lk2nd,device";
};
