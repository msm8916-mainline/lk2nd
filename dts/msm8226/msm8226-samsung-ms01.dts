// SPDX-License-Identifier: BSD-3-Clause

/dts-v1/;

#include <skeleton.dtsi>
#include <lk2nd.h>

/ {
	// This is used by the bootloader to find the correct DTB
	qcom,msm-id =  <0x9e08ff01 0x04 0x20000>;
	
	ms01 {
		model = "Samsung Galaxy S3 Neo";
		compatible = "samsung,ms01", "qcom,msm8226", "lk2nd,device";
		lk2nd,keys =
			<KEY_VOLUMEDOWN 107 (GPIO_PULL_UP | GPIO_ACTIVE_LOW)>,
			<KEY_VOLUMEUP   106 (GPIO_PULL_UP | GPIO_ACTIVE_LOW)>;
	};   
};
