// SPDX-License-Identifier: GPL-2.0-only

/dts-v1/;

#include <skeleton.dtsi>
#include <lk2nd.h>

/ {
	// This is used by the bootloader to find the correct DTB
        qcom,msm-id = <0xdf08ff01 3 0x20000>;
	atlantic3g {
		model = "Samsung Galaxy S5 Mini Duos (G800H)";
		compatible = "samsung,atlantic3g", "qcom,msm8228", "lk2nd,device";
                lk2nd,match-bootloader = "G800H*";

		lk2nd,keys =
			<KEY_VOLUMEDOWN 107 (GPIO_PULL_UP | GPIO_ACTIVE_LOW)>,
			<KEY_VOLUMEUP   106 (GPIO_PULL_UP | GPIO_ACTIVE_LOW)>;

                samsung,muic-reset {
			i2c-gpio-pins = <4 5>;
			i2c-address = <0x25>;
                };
	};
};
