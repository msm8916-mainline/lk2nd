// SPDX-License-Identifier: GPL-2.0-only

/dts-v1/;

/*
 * Compile lk2nd with the following flags so that various lk2nd functionality
 * works fine, e.g. fastboot oem lk_log && fastboot get_staged /dev/stdout
 *
 * SCRATCH_ADDR=0x20000000 SCRATCH_ADDR_512MAP=0x20000000 SCRATCH_SIZE_512MAP=0x10000000
 *
 * On this device the memory at 0x10000000 (default scratch memory address)
 * allows writes but any read just returns zeroes. From Linux perspective this
 * is reserved memory so we need to choose a different memory address.
 */

#include <skeleton.dtsi>
#include <lk2nd.h>

/ {
	/* Actually htc,project-id */
	qcom,msm-id = <293 0 0>;

	memul {
		model = "HTC One Mini 2";
		compatible = "htc,memul", "qcom,msm8926", "lk2nd,device";
		lk2nd,match-cmdline = "* mdss_mdp.panel=1:dsi:0:qcom,mdss_dsi_mem_lg_novatek_35521_720p_video *";

		lk2nd,keys =
			<KEY_VOLUMEDOWN 107 (GPIO_PULL_UP | GPIO_ACTIVE_LOW)>,
			<KEY_VOLUMEUP   108 (GPIO_PULL_UP | GPIO_ACTIVE_LOW)>;
	};
};
