// SPDX-License-Identifier: GPL-2.0-only

/dts-v1/;

#include <skeleton.dtsi>
#include <lk2nd.h>

/ {
	qcom,msm-id = <0x91 0x44 0x82D0>;

	model = "Motorola Moto G 4G 2013";
	compatible = "motorola,peregrine", "qcom,msm8926", "lk2nd,device";
};
