// SPDX-License-Identifier: GPL-2.0-only

/dts-v1/;

#include <skeleton.dtsi>
#include <lk2nd.h>

/ {
	// This is used by the bootloader to find the correct DTB
        qcom,msm-id =  <0x9E08FF01 7 0x20000>;
	kmini3g {
		model = "Samsung Galaxy S5 Mini Duos (SM-G800H)";
		compatible = "samsung,kmini3g", "qcom,msm8926", "lk2nd,device";
		lk2nd,match-bootloader = "G800H*";

		lk2nd,keys =
			<KEY_HOME       108 (GPIO_PULL_UP | GPIO_ACTIVE_LOW)>,
			<KEY_VOLUMEDOWN 107 (GPIO_PULL_UP | GPIO_ACTIVE_LOW)>,
			<KEY_VOLUMEUP   106 (GPIO_PULL_UP | GPIO_ACTIVE_LOW)>;
	};
};
