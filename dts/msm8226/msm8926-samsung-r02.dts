// SPDX-License-Identifier: GPL-2.0-only

/dts-v1/;

#include <skeleton.dtsi>
#include <lk2nd.h>

/ {
	// This is used by the bootloader to find the correct DTB
	qcom,msm-id = <0xC808FF01 2 0x10001>;

	matisselte {
		model = "Samsung Galaxy Tab 4 10.1 LTE (SM-T535)";
		compatible = "samsung,matisselte", "qcom,msm8926", "lk2nd,device";
		lk2nd,match-bootloader = "T535*";

		lk2nd,keys =
			<KEY_HOME       108 (GPIO_PULL_UP | GPIO_ACTIVE_LOW)>,
			<KEY_VOLUMEDOWN 107 (GPIO_PULL_UP | GPIO_ACTIVE_LOW)>,
			<KEY_VOLUMEUP   106 (GPIO_PULL_UP | GPIO_ACTIVE_LOW)>;
	};
};
