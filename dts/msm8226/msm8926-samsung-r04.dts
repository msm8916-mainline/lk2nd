// SPDX-License-Identifier: GPL-2.0-only

/dts-v1/;

#include <skeleton.dtsi>
#include <lk2nd.h>

/ {
	// This is used by the bootloader to find the correct DTB
        qcom,msm-id =  <0x6E08FF01 4 0x20000>;
	kmini3g {
		model = "[ATLANTIC-3G] Rev-03-MTP-v2";
		compatible = "samsung,kmini3g", "qcom,msm8226", "lk2nd,device";
		lk2nd,match-bootloader = "G800H*";

		lk2nd,keys =
			<KEY_HOME       108 (GPIO_PULL_UP | GPIO_ACTIVE_LOW)>,
			<KEY_VOLUMEDOWN 107 (GPIO_PULL_UP | GPIO_ACTIVE_LOW)>,
			<KEY_VOLUMEUP   106 (GPIO_PULL_UP | GPIO_ACTIVE_LOW)>;
	};
};
