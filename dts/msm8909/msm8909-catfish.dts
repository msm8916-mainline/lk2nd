// SPDX-License-Identifier: GPL-2.0-only

/dts-v1/;

#include <skeleton.dtsi>

/ {
	qcom,msm-id = <265 0>, <301 0>;
	qcom,board-id= <8 0x105>;
	lk2nd,match-cmdline = "* mdss_mdp3.panel=1:dsi:0:qcom,mdss_dsi_rm67162_wqvga_cmd:1:none:cfg:single_dsi";

	model = "Mobvoi TicWatch Pro";
	compatible = "mobvoi,catfish", "qcom,msm8909", "lk2nd,device";
};
