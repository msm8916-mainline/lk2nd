// SPDX-License-Identifier: GPL-2.0-only

/dts-v1/;

#include <skeleton.dtsi>

/ {
	qcom,msm-id = <0x12c 0x00>;
	qcom,board-id = <0x0b 0x107>;
	qcom,pmic-id = <0x1000b 0x00 0x00 0x00>;
	lk2nd,match-cmdline = "* mdss_mdp3.panel=1:dsi:0:qcom,mdss_dsi_st7789h2_video:1:none";

	model = "QIHOO W701";
	compatible = "qihoo,w701", "qcom,msm8909", "lk2nd,device";
};
