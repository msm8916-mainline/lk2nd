// SPDX-License-Identifier: GPL-2.0-only

/dts-v1/;

/include/ "msm8916.dtsi"

/ {
        qcom,msm-id =   <206 0>,
			<248 0>,
			<249 0>,
			<250 0>;
	qcom,board-id = <21 0>;
	compatible = "qcom,msm8916-mtp", "qcom,msm8916";
	
	asus-z00l {
		model = "Asus Zenfone 2 Laser (720p)";
		compatible = "asus,z00l", "qcom,msm8916", "lk2nd,device";
		lk2nd,match-cmdline = "*LASER*";
	};
};
