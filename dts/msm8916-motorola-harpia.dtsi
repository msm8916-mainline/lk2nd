// SPDX-License-Identifier: GPL-2.0-only

/dts-v1/;

/include/ "skeleton.dtsi"
/include/ "motorola-carrier-channel-ids.dtsi"

/ {
	qcom,msm-id = <206 0>;

	model = "Motorola Moto G4 Play (harpia)";
	compatible = "motorola,harpia", "qcom,msm8916", "lk2nd,device";

	lk2nd,uart = <1>;
	lk2nd,motorola-unitinfo = <1>;
};
