// SPDX-License-Identifier: GPL-2.0-only
/include/ "msm8916-motorola.dtsi"

/ {
	qcom,board-id = <0x4a 0x82b0>;

	model = "Motorola Moto G 2015 (osprey)";
	compatible = "motorola,osprey", "qcom,msm8916", "lk2nd,device";
};
