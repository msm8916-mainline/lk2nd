// SPDX-License-Identifier: GPL-2.0-only
/include/ "msm8916-motorola.dtsi"

/ {
	qcom,board-id = <0x46 0x8300>;

	model = "Motorola Moto E 2015 LTE (surnia)";
	compatible = "motorola,surnia", "qcom,msm8916", "lk2nd,device";
};
