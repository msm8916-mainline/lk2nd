// SPDX-License-Identifier: GPL-2.0-only

/dts-v1/;

/include/ "msm8916.dtsi"

/ {
	compatible = "qcom,msm8916-mtp", "qcom,msm8916";

	// There are devices that identify themselves as qcom,msm8916-mtp,
	// even when they are really not (at least physically).
	// Therefore we need other things we can match on (e.g. the cmdline).

	marshall-london {
		model = "Marshall London";
		compatible = "marshall,london", "qcom,msm8916", "lk2nd,device";
		lk2nd,match-cmdline = "* hw.id=500";
	};

	alto5-vdf {
		model = "Vodafone Smart prime 6";
		compatible = "alcatel,alto5-vdf", "qcom,msm8916", "lk2nd,device";
		// FIXME: There are multiple possible panels, might need to add more
		lk2nd,match-cmdline = "* mdss_mdp.panel=1:dsi:0:qcom,mdss_dsi_hx8394a_hd_tdt_video:1:none";
	};
};
