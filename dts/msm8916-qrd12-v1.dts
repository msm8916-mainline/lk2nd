// SPDX-License-Identifier: GPL-2.0-only

/dts-v1/;

/include/ "skeleton.dtsi"

/ {
	/* FIXME: Need to split this up if there are more devices with same board-id */
	compatible = "qcom,msm8916-v1-qrd/12-v1", "qcom,msm8916", "lk2nd,device";
	model = "Wingtech WT88047";
};
