// SPDX-License-Identifier: GPL-2.0-only

/dts-v1/;

/include/ "msm8916.dtsi"

/ {
	// This is used by the bootloader to find the correct DTB
	qcom,msm-id = <206 0>;
	qcom,board-id = <0xCE08FF01 4>;

	j5xlte-eur {
		model = "Samsung Galaxy J5 2016 LTE (EUR)";
		compatible = "samsung,j5xlte-eur", "qcom,msm8916", "lk2nd,device";
		lk2nd,match-bootloader = "J510F*";

		samsung,muic-reset {
			i2c-gpio-pins = <105 106>;
			i2c-address = <0x25>;
		};
	};
};
