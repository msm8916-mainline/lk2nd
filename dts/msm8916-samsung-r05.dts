// SPDX-License-Identifier: GPL-2.0-only

/dts-v1/;

/include/ "msm8916.dtsi"

/ {
	// This is used by the bootloader to find the correct DTB
	qcom,msm-id = <206 0>;
	qcom,board-id = <0xCE08FF01 5>;

	j5nlte-eur {
		model = "Samsung J5N EUR PROJECT Rev05";
		compatible = "samsung,j5nlte-eur", "qcom,msm8916", "lk2nd,device";
		lk2nd,match-bootloader = "J500FN*";
		
		samsung,muic-reset {
			i2c-gpios = <105 106>;
			i2c-address = <0x25>;
		};
	};
};
