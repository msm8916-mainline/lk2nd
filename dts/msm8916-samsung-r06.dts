// SPDX-License-Identifier: GPL-2.0-only

/dts-v1/;

/include/ "skeleton.dtsi"

/ {
	// This is used by the bootloader to find the correct DTB
	qcom,msm-id = <206 0>;
	qcom,board-id = <0xCE08FF01 6>;

	gt58ltebmc {
		model = "Samsung Galaxy Tab A 8.0 (CAN)";
		compatible = "samsung,gt58ltebmc", "qcom,msm8916", "lk2nd,device";
		lk2nd,match-bootloader = "T357W*";
	};
};
