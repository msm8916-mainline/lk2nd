// SPDX-License-Identifier: GPL-2.0-only

/dts-v1/;

#include <skeleton.dtsi>

/ {
	qcom,msm-id = <247 0>;
	qcom,board-id = <0xF708FF01 5>;

	gtelwifiue {
		model = "Samsung Galaxy Tab E 9.6 WiFi (SM-T560NU)";
		compatible = "samsung,gtelwifiue", "qcom,apq8016", "lk2nd,device";
		lk2nd,match-bootloader = "T560*";

		samsung,muic-reset {
			i2c-gpio-pins = <2 3>;
			i2c-address = <0x25>;
		};
	};
};
