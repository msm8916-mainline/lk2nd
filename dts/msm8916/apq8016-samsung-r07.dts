// SPDX-License-Identifier: GPL-2.0-only

/dts-v1/;

#include <skeleton.dtsi>

/ {
	// This is used by the bootloader to find the correct DTB
	qcom,msm-id = <247 0>;
	qcom,board-id = <0xF708FF01 7>;

	// Unfortunately, Samsung uses the same qcom,board-id for all its
	// APQ8016 devices. Therefore, it will always pick this shared device
	// tree and we need to do more manual work to differentiate the devices.
	gt510wifi {
		model = "Samsung Galaxy Tab A 9.7 WiFi (2015) (SM-T550)";
		compatible = "samsung,gt510wifi", "qcom,apq8016", "lk2nd,device";
		lk2nd,match-bootloader = "T550*";
	};
};
