// SPDX-License-Identifier: GPL-2.0-only

/dts-v1/;

#include <skeleton.dtsi>

/ {
	// This is used by the bootloader to find the correct DTB
	qcom,msm-id = <248 0>;
	qcom,board-id = <0xF808FF01 5>;

	j53gxx {
		model = "Samsung Galaxy J5 2015 (SM-J500H)";
		compatible = "samsung,j53g", "qcom,msm8916", "lk2nd,device";
		lk2nd,match-bootloader = "J500H*";

		#include "msm8916-samsung-j5.dtsi"
	};
	j5xn3g {
		model = "Samsung Galaxy J5 2016 (SM-J510H)";
		compatible = "samsung,j5xn3g", "qcom,msm8916", "lk2nd,device";
		lk2nd,match-bootloader = "J510H*";

		#include "msm8916-samsung-j5.dtsi"
	};
};
