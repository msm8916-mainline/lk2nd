// SPDX-License-Identifier: GPL-2.0-only

/dts-v1/;

#include <skeleton.dtsi>
#include <lk2nd.h>

/ {
    // This is used by the bootloader to find the correct DTB
	qcom,msm-id = <248 0>;
	qcom,board-id = <0xF808FF01 7>;

    fortuna3g {
		model = "Samsung Galaxy Grand Prime 3G (SM-G530H)";
		compatible = "samsung,fortuna3g", "qcom,msm8916", "lk2nd,device";
		lk2nd,match-bootloader = "G530H*";
		#include "msm8916-samsung-gprime.dtsi"

};

    fortuna3gtv {
		model = "Samsung Galaxy Grand Prime Duos TV (SM-G530BT)";
		compatible = "samsung,fortuna3g", "qcom,msm8916", "lk2nd,device","tv";
		lk2nd,match-bootloader = "G530BT*";
		#include "msm8916-samsung-gprime.dtsi"
	};
};
