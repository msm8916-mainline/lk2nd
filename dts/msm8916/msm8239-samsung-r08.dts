// SPDX-License-Identifier: GPL-2.0-only

/dts-v1/;

#include <skeleton.dtsi>
#include <lk2nd.h>

/ {
	// This is used by the bootloader to find the correct DTB
	qcom,msm-id = <263 0>;
	qcom,board-id = <0x10708FF1 8>;

	a73g {
		model = "Samsung Galaxy A7 (SM-A700H)";
		compatible = "samsung,a73g", "qcom,msm8239", "lk2nd,device";
		lk2nd,match-bootloader = "A700H*";

 	 	qcom,msm-id = <263 0>;
 	 	qcom,board-id = <0x10708FF1 9>;

	};
};

