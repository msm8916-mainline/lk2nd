// SPDX-License-Identifier: GPL-2.0-only

/dts-v1/;

#include <skeleton.dtsi>
#include <lk2nd.h>

/ {
	compatible = "qcom,msm8916-512mb-mtp", "qcom,msm8916";
	qcom,msm-id = <206 0>;
	qcom,board-id = <8 0x100>;
	
	// Also supports UFI003_MB_V02 and MF601 variants
	zhihe-ufi-001c {
		model = "ufi-001b/ufi-001c 4G Modem Stick";
		compatible = "zhihe,ufi-001c", "qcom,msm8916", "lk2nd,device";

		/* Register EDL button as HOME button */
		/* This is the only button on UFI-001C */
		lk2nd,keys = <KEY_HOME 37 (GPIO_PULL_DOWN | GPIO_ACTIVE_HIGH)>,
		// The following keys are found on MF601
		// RESET button on the back of the device
			     <KEY_HOME 34 (GPIO_PULL_UP | GPIO_ACTIVE_LOW)>,
		// WPS button near the power button(may not exist on some variants)
			     <KEY_HOME 107 (GPIO_PULL_UP | GPIO_ACTIVE_LOW)>;
		lk2nd,match-cmdline = "* mdss_mdp.panel=1:spi:0:qcom,mdss_spi_st7735s_128128_cmd";
	};

	/*
	 * Note:
	 * Due to some unknown reasons, the stock aboot firmware is incompatible
	 * with qhypstub and tz firmware from db410c, use lk1st if possible.
	 */

	zhihe-uz801-v3 {
		model = "uz801 v3.0 4G Modem Stick";
		compatible = "zhihe,uz801-v3", "qcom,msm8916", "lk2nd,device";

		/* Register the reset button as HOME button */
		/* This is the only button on this device */
		lk2nd,keys = <KEY_HOME 23 (GPIO_PULL_UP | GPIO_ACTIVE_LOW)>;
		lk2nd,match-cmdline = "* mdss_mdp.panel=1:dsi:0:qcom,mdss_dsi_jdi_1080p_video";
	};
};
