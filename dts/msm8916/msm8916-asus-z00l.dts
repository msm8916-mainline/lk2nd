// SPDX-License-Identifier: GPL-2.0-only

/dts-v1/;

#include <skeleton.dtsi>
#include <lk2nd.h>

/ {
	qcom,msm-id = <206 0>;
	qcom,board-id = <21 0>;
	model = "Asus Zenfone Laser 2 (720p)";
	compatible = "asus,z00l", "qcom,msm8916", "lk2nd,device";

	lk2nd,keys =
		<KEY_VOLUMEDOWN 117 (GPIO_PULL_UP | GPIO_ACTIVE_LOW)>,
		<KEY_VOLUMEUP   107 (GPIO_PULL_UP | GPIO_ACTIVE_LOW)>;

	panel {
		compatible = "asus,z00l-panel";

		qcom,mdss_dsi_otm1284a_720p_video {
			compatible = "asus,z00l-otm1284a";
		};
		qcom,mdss_dsi_cpt5p5_otm1284a_720p_video {
			compatible = "asus,z00l-cpt5p5-otm1284a";
		};
	};
};
