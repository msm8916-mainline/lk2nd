//SPDX-License-Identifier: GPL-2.0-only
/*
Notes regarding the device 'coolpad-coolpady80d':

This device comes with a stock ROM based on Android 4.4 and 1GB RAM.
Therefore, it is considered quirky, and lk1st should be mandatory for mainline to run on this device.
The commented out "yulong," lines are what I left behind initially trying to port lk2nd to the device.
Those are kept in the DTS for reference purposes only.

Regarding the device's DT:
No kernel sources are availble for this device, so I have tried decompiling the device tree extracted from
a known working boot.img file.
However, I attempted using multiple QCDT extractors and they all came back with output that made dtc complain
that it has bad magic. Taking how only an lk2nd-patched known working bootimg would be able to make the stock
bootloader boot into lk2nd (not even lk2nd-appended-dtb.img would boot) into account, the stock bootloader might
be expecting extra magic before the valid device tree data. If that is the case, this would effectively stop
any custom-built kernel from booting at all as long as the stock bootloader still exists in the boot process.

TODO: I may consider looking into the panel's DTSI generated by lmdpdg to get the panel to work in lk1st.
*/

/dts-v1/;

#include <skeleton.dtsi>

/ {

	qcom,msm-id = <206 0>;
	qcom,board-id = <8 0>;
	model = "Coolpad Y80D";
	compatible = "coolpad,coolpady80d", "qcom,msm8916", "lk2nd,device";
//	yulong,pcb-id = <0x0a>;
//	yulong,project-id = "Y80D";

	lk2nd,match-panel;

//	credit to wonderfulShrineMaidenOfParadise for this panel reference (although did not work like usual)
	panel {
		compatible = "coolpad,coolpady80d-panel";

		qcom,mdss_dsi_otm9605a_lide_qhd_video_550 {
			compatible = "coolpad,otm9605-lide";
		};
	};
};
