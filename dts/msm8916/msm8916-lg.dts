// SPDX-License-Identifier: GPL-2.0-only

/dts-v1/;

#include <skeleton.dtsi>
#include <lk2nd.h>

/ {
	// This is used by the bootloader to find the correct DTB
	qcom,msm-id = <206 0>;
	qcom,board-id = <100 0>;

	c50 {
		model = "LG Leon LTE";
		compatible = "lg,c50", "qcom,msm8916", "lk2nd,device";
		lk2nd,match-cmdline = "* model.name=LG-H34*";

		lk2nd,keys =
			<KEY_VOLUMEDOWN 107 (GPIO_PULL_UP | GPIO_ACTIVE_LOW)>,
			<KEY_VOLUMEUP   108 (GPIO_PULL_UP | GPIO_ACTIVE_LOW)>;
	};

	m216 {
		model = "LG K10 (K420n)";
		compatible = "lg,m216", "qcom,msm8916", "lk2nd,device";
		lk2nd,match-cmdline = "* model.name=LG-K420n *";

		lk2nd,keys =
			<KEY_VOLUMEDOWN 108 (GPIO_PULL_UP | GPIO_ACTIVE_LOW)>,
			<KEY_VOLUMEUP   107 (GPIO_PULL_UP | GPIO_ACTIVE_LOW)>;
	};
};
