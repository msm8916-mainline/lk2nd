// SPDX-License-Identifier: GPL-2.0-only

/dts-v1/;

#include <skeleton.dtsi>

/ {
	compatible = "qcom,msm8916-mtp", "qcom,msm8916";

	// There are devices that identify themselves as qcom,msm8916-mtp,
	// even when they are really not (at least physically).
	// Therefore we need other things we can match on (e.g. the cmdline).

	marshall-london {
		model = "Marshall London";
		compatible = "marshall,london", "qcom,msm8916", "lk2nd,device";
		lk2nd,match-cmdline = "* hw.id=500";
	};

	alto5-vdf {
		model = "Vodafone Smart prime 6";
		compatible = "alcatel,alto5-vdf", "qcom,msm8916", "lk2nd,device";
		lk2nd,match-panel;

		panel {
			compatible = "alcatel,alto5-vdf-panel";

			qcom,mdss_dsi_hx8394a_hd_tdt_video {
				compatible = "alcatel,hx8394a-tdt";
			};
			qcom,mdss_dsi_hx8394a_hd_truly_video {
				compatible = "alcatel,hx8394a-truly";
			};
		};
	};

	asus-z010d {
		model = "Asus Zenfone Max ZC550KL";
		compatible = "asus,z010d", "qcom,msm8916", "lk2nd,device";
		lk2nd,match-cmdline = "* mdss_mdp.panel=1:dsi:0:qcom,mdss_dsi_r69339_720p_video:1:none";
	};

	coolpad-coolpady80d {
/*
		This device is very quirky.
		1. This device comes with a stock ROM of Android 4.4 and 1 GB RAM. The stock bootloader lacks ARM64 support.
		2. DTBs extracted from the known working boot.img with any tools other than 'extract-dtb' came back with output that has bad magic.
		One possible theory is that the stock bootloader would expect extra magic before the valid DTB data, which immediately signifies that
		no custom-built kernel could be loaded directly from the stock bootloader.
		2.1 To make lk2nd work, you will need to first patch the known working boot.img using a patch-boot-img.py script from the experimental-rebase
		branch.
		3. No known EDL testpoints or key combos has been found, so one must enter EDL from the lk2nd to flash qhypstub, new TrustZone and lk1st.
		4. LK1ST IS MANDATORY FOR MAINLINE TO RUN ON THIS DEVICE!
*/
		model = "Coolpad Y80D";
		compatible = "coolpad,coolpady80d", "qcom,msm8916", "lk2nd,device";
		lk2nd,match-panel;

		panel {
			compatible = "coolpad,coolpady80d-panel";

			qcom,mdss_dsi_otm9605a_lide_qhd_video_550 {
				compatible = "coolpad,otm9605a-lide-550";
			};
		};
};
