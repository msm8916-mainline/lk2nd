// SPDX-License-Identifier: GPL-2.0-only

/dts-v1/;

/include/ "skeleton.dtsi"

/ {
	compatible = "qcom,msm8916-v1-qrd/12-v1", "qcom,msm8916";

	wingtech-wt88047 {
		compatible = "wingtech,wt88047", "qcom,msm8916", "lk2nd,device";
		model = "Xiaomi Redmi 2 (Wingtech WT88047)";
		lk2nd,match-cmdline = "* mdss_mdp.panel=1:dsi:0:qcom,mdss_dsi_r61308_720p_video:1:none *";
	};
};
