// SPDX-License-Identifier: GPL-2.0-only

/dts-v1/;

#include <skeleton.dtsi>

/ {
	compatible = "qcom,msm8916-v1-qrd/8-v1", "qcom,msm8916";

	lenovo-a6000 {
		model = "Lenovo A6000 (Wingtech WT86518)";
		compatible = "wingtech,wt86518", "qcom,msm8916", "lk2nd,device";
		#include "msm8916-wingtech-wt865x8.dtsi"
	};
};
