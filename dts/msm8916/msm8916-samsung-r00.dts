// SPDX-License-Identifier: GPL-2.0-only

/dts-v1/;

#include <skeleton.dtsi>
#include <lk2nd.h>

/ {
	// This is used by the bootloader to find the correct DTB
	qcom,msm-id = <206 0>;
	qcom,board-id = <0xCE08FF01 0>;

	gt58lte-aus {
		model = "Samsung Galaxy Tab A 8.0 2015 (SM-T355Y)";
		compatible = "samsung,gt58", "qcom,msm8916", "lk2nd,device";
		lk2nd,match-bootloader = "T355Y*";
	};

	coreprimelte {
		// In the downstream dts it is called Samsung ROSSA PROJECT Rev00
		model = "Samsung Galaxy Core Prime LTE (SM-G360F)";
		compatible = "samsung,coreprimelte", "qcom,msm8916", "lk2nd,device";
		lk2nd,match-bootloader = "G360F*";

		qcom,msm-id = <206 0>;
		qcom,board-id = <0xCE08FF01 1>;

		samsung,muic-reset {
			i2c-gpio-pins = <2 3>;
			i2c-address = <0x14>;
		};
	};
};
