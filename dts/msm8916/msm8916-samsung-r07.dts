// SPDX-License-Identifier: GPL-2.0-only

/dts-v1/;

#include <skeleton.dtsi>
#include <lk2nd.h>

/ {
    // This is used by the bootloader to find the correct DTB
	qcom,msm-id = <206 0>;
	qcom,board-id = <0xCE08FF01 7>;

    fortuna3g {
		model = "Samsung Galaxy Grand Prime 3G (SM-G530H)";
		compatible = "samsung,fortuna3g", "qcom,msm8916", "lk2nd,device";
		lk2nd,match-bootloader = "G530H*";

		lk2nd,keys = <KEY_HOME 109 (GPIO_PULL_UP | GPIO_ACTIVE_LOW)>;

		samsung,muic-reset {
			i2c-gpio-pins = <2 3>;
			i2c-address = <0x25>;
		};
	};
};