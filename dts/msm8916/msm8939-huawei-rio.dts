// SPDX-License-Identifier: GPL-2.0-only

/dts-v1/;

#include <skeleton.dtsi>

/ {
	qcom,msm-id = <239 0>;
	qcom,board-id =
		<8054 4>, <8055 4>, <8070 4>, <8071 4>,
		<8086 4>, <8087 4>, <8102 4>, <8134 4>, 
		<8135 4>, <8118 4>;
		
	model = "Huawei G8 / GX8 / RIO-L01";
	compatible = "huawei,rio", "qcom,msm8939", "lk2nd,device";
};
