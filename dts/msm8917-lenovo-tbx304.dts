// SPDX-License-Identifier: GPL-2.0-only

/dts-v1/;

/include/ "msm8952.dtsi"

/ {
	qcom,msm-id = <303 0x0>, <307 0x0>, <308 0x0>, <309 0x0>;
	qcom,board-id= <0x1000b 0>;

	model = "Lenovo Tab4 10 (tbx304)";
	compatible = "lenovo,tbx304", "qcom,msm8917", "lk2nd,device";
};