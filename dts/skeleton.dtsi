// SPDX-License-Identifier: GPL-2.0-only
// Copyright (c) 2013-2015, The Linux Foundation. All rights reserved.

/ {
	#address-cells = <2>;
	#size-cells = <2>;

	// The bootloader gets really sad if it cannot find those nodes
	chosen { };

	memory@0 {
		device_type = "memory";
		/* We expect the bootloader to fill in the reg */
		reg = <0 0 0 0>;
	};
};
