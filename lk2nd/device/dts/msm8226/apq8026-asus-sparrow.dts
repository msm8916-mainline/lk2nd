// SPDX-License-Identifier: BSD-3-Clause

#include <skeleton64.dtsi>
#include <lk2nd.dtsi>

/ {
	qcom,msm-id = <QCOM_ID_APQ8026 0x20000>;
	qcom,board-id = <QCOM_BOARD_ID_MTP 3005>;
};

&lk2nd {
	model = "ASUS ZenWatch 2";
	compatible = "asus,sparrow";

	lk2nd,single-key-navigation;
	lk2nd,dtb-files = "apq8026-asus-sparrow";
};
