// SPDX-License-Identifier: GPL-2.0-only
 
#include <skeleton64.dtsi>
#include <lk2nd.dtsi>

/ {
	// This is used by the bootloader to find the correct DTB
	qcom,msm-id = <206 0>;
	qcom,board-id = <0x1000b 0x8>, <0x11000b 0x8>, <0x21000b 0x8>;
};

&lk2nd {
	model = "Andromax A"; // FIXME
	compatible = "andromax,a16c3h"; // FIXME

  lk2nd,dtb-files = "msm8916-andromax-a16c3h";

};
