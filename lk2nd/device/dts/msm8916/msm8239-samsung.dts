// SPDX-License-Identifier: BSD-3-Clause

#include <skeleton64.dtsi>
#include <lk2nd.dtsi>

#define I2C_GPIO_FLAGS	(GPIO_ACTIVE_HIGH | GPIO_OPEN_DRAIN | GPIO_BIAS_DISABLE)

/ {
	qcom,msm-id = <QCOM_ID_MSM8239 0>;
	qcom,board-id = <0x10708FF1 8>,
			<0x10708FF1 9>;
};

&lk2nd {
	/* rev 9 */

	a73gxx {
		model = "Samsung Galaxy A7 (SM-A700H)";
		compatible = "samsung,a73g", "samsung,a7";
		lk2nd,match-bootloader = "A700H*";

		lk2nd,dtb-files = "msm8939-samsung-a7";

		qcom,msm-id = <QCOM_ID_MSM8239 0>;
		qcom,board-id = <0x10708FF1 9>;
	};
};
