// SPDX-License-Identifier: BSD-3-Clause

#include <skeleton64.dtsi>
#include <lk2nd.dtsi>

/*
 * To build for motorola-cedric, add LK2ND_DTBS="msm8937-motorola-cedric.dtb"
 * to your make cmdline.
 * cedric does not work with all dtbs enabled; the bootloader gets upset and
 * goes into bootloop.
 */

/ {
	qcom,msm-id = <QCOM_ID_MSM8937 0x00>;
	qcom,board-id = <0x41 0x8100>,
			<0x41 0x8200>,
			<0x41 0x8300>,
			<0x42 0x8400>,
			<0x42 0x8500>;
};

&lk2nd {
	cedric {
		model = "Motorola Moto G5 (cedric)";
		compatible = "motorola,cedric";
		lk2nd,match-device = "cedric";

		lk2nd,dtb-files = "msm8937-motorola-cedric";
	};
};
