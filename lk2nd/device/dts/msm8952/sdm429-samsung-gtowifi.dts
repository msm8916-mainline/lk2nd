// SPDX-License-Identifier: BSD-3-Clause

/dts-v1/;

#include <skeleton64.dtsi>
#include <lk2nd.dtsi>

/ {
	qcom,msm-id = <QCOM_ID_SDM429 0>;
	qcom,board-id = <QCOM_BOARD_ID_MTP 0>;
/* Bootloader appears to really want to access symbols */
	__symbols__ {};
};

&lk2nd {
	model = "Samsung Galaxy Tab A 8.0 2019";
	compatible = "samsung,gtowifi";
	lk2nd,match-bootloader = "T290*";

	lk2nd,dtb-files = "sdm429-samsung-gtowifi";
};