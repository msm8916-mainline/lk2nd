// SPDX-License-Identifier: BSD-3-Clause

/dts-v1/;

#include <skeleton64.dtsi>
#include <lk2nd.dtsi>

/ {
	model = "Qualcomm Technologies, Inc. SDA450 + PMI632 SOC";
	compatible = "qcom,sda450";
	qcom,msm-id = <0x15f 0x00>;
	qcom,msm-name = "SDA450";
	interrupt-parent = <0x01>;
	qcom,pmic-id = <0x10016 0x25 0x00 0x00>;
	qcom,pmic-name = "PMI632";
	__symbols__ {}; // Bootloader appears to really want to access symbols
};

&lk2nd {
    model="Lenovo TAB M10 FHD Rel";
    compatible = "lenovo,tbx605fc", "qcom,sda450";

    lk2nd,dtb-files = "sda450-lenovo-tbx605fc";
};
