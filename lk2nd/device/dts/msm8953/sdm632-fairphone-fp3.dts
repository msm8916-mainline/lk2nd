// SPDX-License-Identifier: GPL-2.0-only

/dts-v1/;

#include <skeleton64.dtsi>
#include <lk2nd.dtsi>

/ {
	model = "Fairphone 3";
	qcom,msm-id = <QCOM_ID_SDM632 0>;
	qcom,pmic-id = <0x10016 0x25 0x00 0x00>;
	qcom,board-id = <QCOM_BOARD_ID_MTP 3>;
	/* Bootloader appears to really want to access symbols */
	__symbols__ {};
};

&lk2nd {
	model = "Fairphone 3";
	compatible = "fairphone,fp3";

	lk2nd,dtb-files = "sdm632-fairphone-fp3";
};
