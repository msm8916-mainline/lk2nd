// SPDX-License-Identifier: GPL-2.0-only

/dts-v1/;

#include <skeleton64.dtsi>
#include <lk2nd.dtsi>
#include <motorola-carrier-channel-ids.dtsi>

/ {
	/* model|msm-name|pmic appears to be required by bootloader to pick dtb */

	model = "Qualcomm Technologies, Inc. SDM632 + PMI632 MTP S3";
	qcom,msm-name = "SDM632";
	qcom,msm-id = <QCOM_ID_SDM632 0>;
	qcom,pmic-id = <0x10016 0x25 0x00 0x00>;
	qcom,board-id = <QCOM_BOARD_ID_MTP 3>;
	/* Bootloader appears to really want to access symbols */
	__symbols__ {};
};

&lk2nd {
	model = "Motorola G7 Power (Ocean)";
	compatible = "motorola,ocean";

	lk2nd,dtb-files = "sdm632-motorola-ocean";

	unit-info {
		compatible = "motorola,unit-info";
	};
};
