// SPDX-License-Identifier: GPL-2.0-only

/dts-v1/;

#include <skeleton64.dtsi>
#include <lk2nd.dtsi>
#include <motorola-carrier-channel-ids.dtsi>

/ {
	model = "Qualcomm Technologies, Inc. SDM632 + PMI632 MTP S3";
	compatible = "qcom,sdm632-mtp", "qcom,sdm632", "qcom,mtp";
	qcom,msm-id = <0x15d 0x00>;
	qcom,msm-name = "SDM632";
	qcom,pmic-id = <0x10016 0x25 0x00 0x00>;
	qcom,board-id = <0x45 0xb1b0>, <0x45 0xa100>, <0x45 0xa200>, <0x145 0xa100>, <0x145 0xa200>;

	__symbols__ {};
};

&lk2nd {
	model = "Motorola G7 (River)";
	compatible = "motorola,river";

	lk2nd,dtb-files = "sdm632-motorola-river";

	unit-info {
		compatible = "motorola,unit-info";
	};
};
