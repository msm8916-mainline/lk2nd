// SPDX-License-Identifier: GPL-2.0-only

#include <skeleton64.dtsi>
#include <lk2nd.dtsi>

/ {
	qcom,msm-id = <QCOM_ID_MSM8992 0>, <252 0>;
	qcom,board-id = <0xb64 0>;
	qcom,pmic-id = <0x10009 0x1000a 0x00 0x00>;
};

&lk2nd {
	model = "LG G4 (International)";
	compatible = "lg,h815";
};
