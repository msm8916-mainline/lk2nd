// SPDX-License-Identifier: BSD-3-Clause

#include <skeleton64.dtsi>
#include <lk2nd.dtsi>

/ {
	qcom,msm-id = <QCOM_ID_MSM8996 0x10000>;
	qcom,board-id = <0xc08 0x00>;
	qcom,pmic-id = <0x20009 0x10013 0x00 0x00>;
};

&lk2nd {
	h850 {
		model = "LG G5 (H850)";
		compatible = "lg,h850";
		lk2nd,match-cmdline = "*androidboot.serialno=LGH850*";
	};

	rs988 {
		model = "LG G5 (RS988)";
		compatible = "lg,rs988";
		lk2nd,match-cmdline = "*androidboot.serialno=RS988*";
	};
};
