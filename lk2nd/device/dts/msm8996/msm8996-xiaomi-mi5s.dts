// SPDX-License-Identifier: BSD-3-Clause

#include <skeleton64.dtsi>
#include <lk2nd.dtsi>

/ {
	qcom,msm-id =
		<QCOM_ID_MSM8996 0x30000>,
		<QCOM_ID_MSM8996 0x30001>,
		<QCOM_ID_MSM8996SG 0x10000>;
	qcom,board-id = <37 0>;
	qcom,pmic-id = <0x20009 0x10013 0x00 0x00>;
};

&lk2nd {
	model = "Xiaomi Mi 5s";
	compatible = "xiaomi,capricorn";
};
