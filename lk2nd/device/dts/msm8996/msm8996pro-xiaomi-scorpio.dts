// SPDX-License-Identifier: BSD-3-Clause

#include <skeleton64.dtsi>
#include <lk2nd.dtsi>

/ {
	qcom,msm-id = <QCOM_ID_MSM8996SG 0x10000>;
	qcom,board-id = <34 0>;
	qcom,pmic-id = <0x20009 0x10013 0x00 0x00>;
};

&lk2nd {
	model = "Xiaomi Mi Note 2";
	compatible = "xiaomi,scorpio";
};
