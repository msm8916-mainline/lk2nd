
global &KERNEL_SRC
global &KERNEL_ELF

&KERNEL_SRC="../"

sys.down

global &SURF

if ("&SURF"=="7k")
(
  &KERNEL_ELF="../build-aboot-surf7k/lk"
  do config_a11.cmm
)
else
(
  &KERNEL_ELF="../build-aboot-surf8k/lk"
  do config_scorpion.cmm
)

sys.mode attach

if state.run() 
(
  break
)

data.load.ELF &KERNEL_ELF /RELPATH /PATH &KERNEL_SRC

register.set pc 0
register.set r0 0
;register.set r1 &MACHINE_ID
;register.set r2 &TAGS_ADDR

tronchip.set dabort off
tronchip.set pabort off

term.reset
term.size 70 100
term.scroll.on
term

break.select program onchip
break.delete
;break.set platform_early_init

go

